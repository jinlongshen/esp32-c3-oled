## sdkconfig.defaults
```kconfig
CONFIG_IDF_TARGET="esp32c3"

# C++ Environment
CONFIG_COMPILER_CXX_EXCEPTIONS=n
CONFIG_COMPILER_CXX_RTTI=n
CONFIG_COMPILER_OPTIMIZATION_DEBUG=y

# Override some defaults so BT stack is enabled and
CONFIG_BT_ENABLED=y
CONFIG_BT_NIMBLE_ENABLED=y

## For Bluedroid as binary is larger than default size
CONFIG_PARTITION_TABLE_CUSTOM=y
CONFIG_PARTITION_TABLE_CUSTOM_FILENAME="partitions.csv"
CONFIG_PARTITION_TABLE_FILENAME="partitions.csv"
```
